## buildroot/Config.in
```kconfig
menu "SVRT packages"
source "$BR2_EXTERNAL_SVRT_PATH/package/rpi-ffmpeg/Config.in"
source "$BR2_EXTERNAL_SVRT_PATH/package/svrt/Config.in"
endmenu
```

## buildroot/configs/svrt_raspberrypi4_64_defconfig
```kconfig
BR2_aarch64=y
BR2_cortex_a72=y
BR2_TOOLCHAIN_BUILDROOT_GLIBC=y
BR2_ROOTFS_DEVICE_CREATION_DYNAMIC_EUDEV=y
BR2_PACKAGE_BUSYBOX_SHOW_OTHERS=y
BR2_PACKAGE_RPI_FIRMWARE=y
BR2_PACKAGE_LIBDRM=y
BR2_PACKAGE_SDL2=y
BR2_PACKAGE_SDL2_KMSDRM=y
BR2_PACKAGE_RPI_FFMPEG=y
BR2_PACKAGE_SVRT=y
BR2_TARGET_ROOTFS_EXT2=y
BR2_TARGET_ROOTFS_EXT2_4=y
BR2_TARGET_ROOTFS_EXT2_SIZE="512M"
BR2_LINUX_KERNEL=y
BR2_LINUX_KERNEL_DEFCONFIG="bcm2711"
BR2_LINUX_KERNEL_DTS_SUPPORT=y
BR2_LINUX_KERNEL_INTREE_DTS_NAME="broadcom/bcm2711-rpi-4-b"
```

## buildroot/package/rpi-ffmpeg/Config.in
```kconfig
config BR2_PACKAGE_RPI_FFMPEG
    bool "Raspberry Pi FFmpeg with V4L2 request HEVC"
    depends on BR2_PACKAGE_HAS_UDEV
    depends on BR2_PACKAGE_LIBDRM
    depends on BR2_PACKAGE_ZLIB
    help
      Raspberry Pi downstream FFmpeg containing the stateless V4L2 request decoder.
```

## buildroot/package/svrt/Config.in
```kconfig
config BR2_PACKAGE_SVRT
    bool "svrt"
    depends on BR2_USE_MMU
    depends on BR2_PACKAGE_SDL2_KMSDRM
    select BR2_PACKAGE_RPI_FFMPEG
    select BR2_PACKAGE_LIBDRM
    select BR2_PACKAGE_SDL2
    help
      SteamVR HEVC hardware decoder and KMSDRM receiver.

config BR2_PACKAGE_SVRT_LOCAL_PATH
    string "SVRT local source path"
    default "/svrt"
    depends on BR2_PACKAGE_SVRT
```
